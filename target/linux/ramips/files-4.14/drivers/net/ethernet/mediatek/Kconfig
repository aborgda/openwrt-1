## target/linux/ramips/files-4.14/drivers/net/ethernet/mediatek/Kconfig
```kconfig
config NET_VENDOR_MEDIATEK
	tristate "Mediatek/Ralink ethernet driver"
	depends on RALINK
	help
	  This driver supports the ethernet mac inside the Mediatek and Ralink WiSoCs

if NET_VENDOR_MEDIATEK
choice
	prompt "MAC type"

config NET_MEDIATEK_RT2880
	bool "RT2882"
	depends on MIPS && SOC_RT288X

config NET_MEDIATEK_RT3050
	bool "RT3050/MT7628"
	depends on MIPS && (SOC_RT305X || SOC_MT7620)

config NET_MEDIATEK_RT3883
	bool "RT3883"
	depends on MIPS && SOC_RT3883

config NET_MEDIATEK_MT7620
	bool "MT7620"
	depends on MIPS && SOC_MT7620

config NET_MEDIATEK_MT7621
	bool "MT7621"
	depends on MIPS && SOC_MT7621

endchoice

config NET_MEDIATEK_OFFLOAD
	def_bool y
	depends on NET_MEDIATEK_MT7621 || NET_MEDIATEK_MT7620

endif
```
